## drivers/net/wireless/mediatek/mt7668/Kconfig
```kconfig
menu "mt7668"

config MTK_COMBO_CHIP
	string "MTK COMBO CHIP"
	default "MT7668"

config MTK_WIFI_ONLY
	tristate "MTK WIFI ONLY"
	default m

endmenu
```

## drivers/net/wireless/realtek/rtl8822bu/Kconfig
```kconfig
config RTL8822BU
	tristate "Realtek 8822BU USB WiFi"
	depends on USB
	help
	  Help message of RTL8822BU
```

## drivers/net/wireless/realtek/rtl8822cs/Kconfig
```kconfig
config RTL8822CS
	tristate "Realtek 8822CS SDIO WiFi"
	help
	  Help message of RTL8822CS
```

## drivers/net/wireless/realtek/rtl88x2bu/Kconfig
```kconfig
config RTL8822BU
	tristate "Realtek 8822BU USB WiFi"
	depends on USB
	help
	  RTL88X2BU driver updated for current kernels.
```
